## meta-playground/conf/distro/lux.conf
```bitbake
DISTRO = "lux"
DISTRO_NAME = "Lux (Sandbox Distribution)"
DISTRO_VERSION = "1.0"
DISTRO_CODENAME = "styhead"

SDK_VERSION = "${DISTRO_VERSION}"

DISTRO_FEATURES ?= "virtualization multiarch seccomp"

PREFERRED_VERSION_linux-yocto ?= "6.10%"
PREFERRED_VERSION_linux-yocto-rt ?= "6.10%"

SDK_NAME = "${DISTRO}-${TCLIBC}-${SDKMACHINE}-${IMAGE_BASENAME}-${TUNE_PKGARCH}-${MACHINE}"
SDK_VENDOR = "-luxsdk"

SDKPATHINSTALL = "/opt/${DISTRO}/${SDK_VERSION}"

DISTRO_EXTRA_RDEPENDS += "packagegroup-core-boot"
DISTRO_EXTRA_RRECOMMENDS += ""

PACKAGE_CLASSES ?= "package_rpm"

TCLIBC = "glibc"

INIT_MANAGER ?= "sysvinit"

require conf/distro/include/poky-world-exclude.inc
require conf/distro/include/no-static-libs.inc
require conf/distro/include/yocto-uninative.inc
require conf/distro/include/security_flags.inc
require conf/distro/include/yocto-space-optimize.inc

INHERIT += "uninative"
INHERIT += "poky-sanity"
INHERIT += "create-spdx"
```
